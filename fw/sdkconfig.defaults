## fw/sdkconfig.defaults
```kconfig
# 小圆脸固件 · 板级默认配置 (Waveshare ESP32-S3-Touch-AMOLED-1.75)
# ESP32-S3R8: 32MB Flash(quad) + 8MB Octal PSRAM

CONFIG_IDF_TARGET="esp32s3"

# --- Flash 32MB ---
CONFIG_ESPTOOLPY_FLASHSIZE_32MB=y
CONFIG_ESPTOOLPY_FLASHMODE_QIO=y
CONFIG_ESPTOOLPY_FLASHFREQ_80M=y

# --- 8MB Octal PSRAM（给显示帧缓冲用）---
CONFIG_SPIRAM=y
CONFIG_SPIRAM_MODE_OCT=y
CONFIG_SPIRAM_SPEED_80M=y
CONFIG_SPIRAM_USE_MALLOC=y

# --- 主频 240MHz ---
CONFIG_ESP_DEFAULT_CPU_FREQ_MHZ_240=y

# --- 编译优化 -O2（浮点渲染循环要性能）---
CONFIG_COMPILER_OPTIMIZATION_PERF=y

# --- 自定义分区表 ---
CONFIG_PARTITION_TABLE_CUSTOM=y
CONFIG_PARTITION_TABLE_CUSTOM_FILENAME="partitions.csv"

# --- 控制台走 USB-Serial/JTAG（原生 USB，免外置串口）---
CONFIG_ESP_CONSOLE_USB_SERIAL_JTAG=y

# --- 日志 ---
CONFIG_LOG_DEFAULT_LEVEL_INFO=y

# --- LVGL（设置页）---
CONFIG_LV_COLOR_DEPTH_16=y

# LVGL 在主任务渲染，栈要大（默认 3584 会爆）
CONFIG_ESP_MAIN_TASK_STACK_SIZE=16384
```
